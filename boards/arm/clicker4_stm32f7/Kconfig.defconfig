## boards/arm/clicker4_stm32f7/Kconfig.defconfig
```kconfig
# SPDX-License-Identifier: Apache-2.0

if BOARD_CLICKER4_STM32F7

config GPIO
	default y

config CLOCK_CONTROL
	default y

config PINCTRL
	default y

endif # BOARD_CLICKER4_STM32F7
```

## boards/arm/clicker4_stm32f7/clicker4_stm32f7_defconfig
```kconfig
# SPDX-License-Identifier: Apache-2.0

# Enable GPIO
CONFIG_GPIO=y

# Enable Clocks
CONFIG_CLOCK_CONTROL=y

# Enable pin controller
CONFIG_PINCTRL=y

# Main thread stack default for board bring-up
CONFIG_MAIN_STACK_SIZE=4096
```

## west-manifest/west.yml
```yaml
manifest:
  remotes:
    - name: zephyrproject
      url-base: https://github.com/zephyrproject-rtos
  projects:
    - name: zephyr
      repo-path: zephyr
      remote: zephyrproject
      revision: v4.3.0
      clone-depth: 1
      import:
        path-prefix: external
        name-allowlist:
          - mcuboot
          - hal_st
          - hal_stm32
          - cmsis
          - cmsis_6
          - hal_tdk
          - segger

  self:
    path: .

# Configure west to find custom boards
build:
  board-root: .
```
